## config/west.yml
```yaml
manifest:
  remotes:
    - name: zmkfirmware
      url-base: https://github.com/zmkfirmware
    - name: urob
      url-base: https://github.com/urob
    - name: stijnveenman
      url-base: https://github.com/stijnveenman
  projects:
    - name: zmk
      remote: urob
      revision: main
      import: app/west.yml
    - name: zmk-helpers
      remote: urob
      revision: a98b7f7e4a5130a5150dce81bb8aa419fc3ca3c0
  self:
    path: config
```
